## boards/shields/leftsplithalf/Kconfig.defconfig
```kconfig
if SHIELD_LEFTSPLITHALF

config ZMK_KEYBOARD_NAME
    default "leftsplithalf"

endif
```

## boards/shields/leftsplithalf/Kconfig.shield
```kconfig
config SHIELD_LEFTSPLITHALF
    def_bool $(shields_list_contains, leftsplithalf)
```
